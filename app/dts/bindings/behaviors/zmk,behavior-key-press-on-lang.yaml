## app/dts/bindings/behaviors/zmk,behavior-key-press-on-lang.yaml
```yaml
# Copyright (c) 2024 The ZMK Contributors
# SPDX-License-Identifier: MIT

description: Press key on specific language

compatible: "zmk,behavior-key-press-on-lang"

include: zero_param.yaml
```

## app/dts/bindings/behaviors/zmk,behavior-language.yaml
```yaml
# Copyright (c) 2024 The ZMK Contributors
# SPDX-License-Identifier: MIT

description: Language change behavior

compatible: "zmk,behavior-language"

include: one_param.yaml

properties:
  bindings:
    type: phandle-array
    required: true
  layers:
    type: array
```
